## discharge.its
```
/dts-v1/;

/ {
    description = "Discharge payload for Depthcharge";
    #address-cells = <1>;

    images {

        kernel@1 {
            data = /incbin/("discharge.bin");
            type = "kernel";
            arch = "arm64";
            os = "linux";
            compression = "none";
            load = <0x80000000>;
            entry = <0x80000000>;
        };

        /*
         * FIXME: This should be replaced with a compiled device tree,
         * but right now it's not being used, so we're sticking this blob
         * in as a stub.
         */
        fdt@1 {
            description = "placeholder";
            data = /incbin/("placeholder.dtb");
            type = "flat_dt";
            arch = "arm64";
            compression = "none";
            hash@1 {
                algo = "sha1";
            };
        };

        /**
         * Depthcharge only supports simple loads: we can only load a single
         * kernel, device tree, and ramdisk -- and none of these are in the
         * particular format that Xen expects. To pass it Xen as well, we
         * coalesce all of the images we want into a second "payload" fit image,
         * and then pass that in as a ramdisk. Discharge will then bootstrap the
         * system from this new fit image.
         */
        ramdisk@1 {
            description = "Discharge payload";
            data = /incbin/("subimage/subimage.fit");
            type = "ramdisk";
            arch = "arm64";
            compression = "none";
            hash@1 {
                algo = "sha1";
            };
        };


    };

    configurations {
        default = "conf@1";

        conf@1 {
            description = "Discharge, fdt, and payload";
            kernel = "kernel@1";
            fdt = "fdt@1";
            ramdisk = "ramdisk@1";
        };
    };
};
```

## subimage/linux_only.its
```
/dts-v1/;

/ {
    description = "Linux payload for testing";
    #address-cells = <1>;

    images {

        kernel@1 {
            description = "Linux";
            data = /incbin/("Image");
            type = "kernel";
            arch = "arm64";
            os = "linux";
            compression = "none";
            load = <0x80100000>;
            entry = <0x80100000>;

            hash@1 {
                algo = "sha1";
            };
        };

        fdt@1 {
            description = "Device Tree for the Pixel C";
            data = /incbin/("xen.dtb");
            type = "flat_dt";
            arch = "arm64";
            load = <0x80300000>;

            compression = "none";
            hash@1 {
                algo = "sha1";
            };
        };

    };

    configurations {
        default = "conf@1";

        conf@1 {
            description = "Discharge, fdt, and payload";
            kernel = "kernel@1";
            fdt = "fdt@1";
        };
    };
};
```

## subimage/subimage.its
```
/dts-v1/;

/ {
    description = "Xen/Linux payload for Discharge";
    #address-cells = <1>;

    images {

        xen_kernel@1 {
            description = "Xen Hypervisor";
            data = /incbin/("xen");
            type = "kernel";
            arch = "arm64";
            os = "linux";
            compression = "none";
            load = <0x80100000>;
            entry = <0x80100000>;

            hash@1 {
                algo = "sha1";
            };
        };

        fdt@1 {
            description = "Device Tree for the Pixel C";
            data = /incbin/("xen.dtb");
            type = "flat_dt";
            arch = "arm64";
            load = <0x80300000>;

            compression = "none";
            hash@1 {
                algo = "sha1";
            };
        };

        linux_kernel@1 {
            description = "dom0 linux image";
            data = /incbin/("Image");
            type = "kernel";
            arch = "arm64";
            os = "linux";
            compression = "none";
            load = <0x80320000>;

            hash@1 {
                algo = "sha1";
            };
        };


    };

    configurations {
        default = "conf@1";

        conf@1 {
            description = "Discharge, fdt, and payload";
            kernel = "kernel@1";
            fdt = "fdt@1";
            loadables = "linux_kernel@1";
        };
    };
};
```
